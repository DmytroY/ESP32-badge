#include "ST7789_76x284.h"

// font_5x7
static const uint8_t font_5x7[][7] PROGMEM = {
{0x00, 0x00, 0x00, 0x00, 0x00, 0x00, 0x00}, // ' '
{0x04, 0x04, 0x04, 0x04, 0x04, 0x00, 0x04}, // !
{0x0a, 0x0a, 0x0a, 0x00, 0x00, 0x00, 0x00}, // "
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{0x1F, 0x1F, 0x1F, 0x1F, 0x1F, 0x1F, 0x1F}, // filled
};

// font 10x14
static const uint16_t font_10x14[][14] PROGMEM = {
{0x0000, 0x0000, 0x0000, 0x0000, 0x0000, 0x0000, 0x0000, 0x0000, 0x0000, 0x0000, 0x0000, 0x0000, 0x0000, 0x0000}, // ' ' 
{0x0030, 0x0030, 0x0030, 0x0030, 0x0030, 0x0030, 0x0030, 0x0030, 0x0030, 0x0030, 0x0000, 0x0000, 0x0030, 0x0030}, // !
{0x00cc, 0x00cc, 0x00cc, 0x00cc, 0x00cc, 0x00cc, 0x0000, 0x0000, 0x0000, 0x0000, 0x0000, 0x0000, 0x0000, 0x0000}, // "
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{0x03FF, 0x03FF, 0x03FF, 0x03FF, 0x03FF, 0x03FF, 0x03FF, 0x03FF, 0x03FF, 0x03FF, 0x03FF, 0x03FF, 0x03FF, 0x03FF} // filled
};

// font 15x21
static const uint16_t font_15x21[][21] PROGMEM = {
{0x0000, 0x0000, 0x0000, 0x0000, 0x0000, 0x0000, 0x0000, 0x0000, 0x0000, 0x0000, 0x0000, 0x0000, 0x0000, 0x0000, 0x0000, 0x0000, 0x0000, 0x0000, 0x0000, 0x0000, 0x0000}, // ' '
{0x01C0, 0x01C0, 0x01C0, 0x01C0, 0x01C0, 0x01C0, 0x01C0, 0x01C0, 0x01C0, 0x01C0, 0x01C0, 0x01C0, 0x01C0, 0x01C0, 0x0080, 0x0000, 0x0000, 0x0000, 0x01C0, 0x01C0, 0x01C0}, // !
{0x0E38, 0x0E38, 0x0618, 0x0E38, 0x0C30, 0x0820, 0x0000, 0x0000, 0x0000, 0x0000, 0x0000, 0x0000, 0x0000, 0x0000, 0x0000, 0x0000, 0x0000, 0x0000, 0x0000, 0x0000, 0x0000}, // "
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{0x7FFF, 0x7FFF, 0x7FFF, 0x7FFF, 0x7FFF, 0x7FFF, 0x7FFF, 0x7FFF, 0x7FFF, 0x7FFF, 0x7FFF, 0x7FFF, 0x7FFF, 0x7FFF, 0x7FFF, 0x7FFF, 0x7FFF, 0x7FFF, 0x7FFF, 0x7FFF, 0x7FFF}, // filed
};

ST7789_76x284::ST7789_76x284(uint16_t w, uint16_t h, uint16_t x_off, uint16_t y_off)
    : _w(w), _h(h), _x_off(x_off), _y_off(y_off) {}

void ST7789_76x284::begin(int8_t sclk, int8_t mosi, int8_t cs, int8_t dc, int8_t rst, int8_t bl){
    _cs = cs;
    _dc = dc;
    _rst = rst;
    _bl = bl;
    pinMode(_rst, OUTPUT);
    pinMode(_cs,  OUTPUT);
    pinMode(_dc,  OUTPUT);
    digitalWrite(_cs, HIGH);

    SPI.begin(sclk, -1, mosi, _cs);
    SPI.setFrequency(8000000);
    SPI.setDataMode(SPI_MODE0);
    SPI.setBitOrder(MSBFIRST);

    //TFT init procedure
    digitalWrite(_rst, HIGH); delay(10);
    digitalWrite(_rst, LOW);  delay(50);
    digitalWrite(_rst, HIGH); delay(150);

    send_cmd(0x01); delay(150);  // Software reset
    send_cmd(0x11); delay(255);  // Sleep out
    
    uint8_t colmod[] = { 0x55 };           // 16-bit color
    send_cmd_data(0x3A, colmod, 1); delay(10);

    uint8_t madctl;
    if(_w > _h){
        madctl = { 0x68 };           // MX + MV + BGR (landscape)
    } else {
        madctl = { 0x08 };           // BGR, (portrait)
    }
    send_cmd_data(0x36, &madctl, 1);

    send_cmd(0x20); delay(10);   // invertion OFF
    send_cmd(0x13); delay(10);   // Partial mode OFF
    send_cmd(0x29); delay(255);  // Display ON
    
    initPWM(_bl); // init PWM for backlight
    setBrightness(50); //brightness 50%

}

void ST7789_76x284::write_byte(uint8_t b){SPI.transfer(b);}

void ST7789_76x284::send_cmd(uint8_t cmd){
    digitalWrite(_dc, LOW);
    digitalWrite(_cs, LOW);
    write_byte(cmd);
    digitalWrite(_cs, HIGH);
}

void ST7789_76x284::send_data(uint8_t data){
    digitalWrite(_dc, HIGH);
    digitalWrite(_cs, LOW);
    write_byte(data);
    digitalWrite(_cs, HIGH);
}

void ST7789_76x284::send_cmd_data(uint8_t cmd, const uint8_t* data, uint8_t len){
    digitalWrite(_dc, LOW);
    digitalWrite(_cs, LOW);
    write_byte(cmd);
    digitalWrite(_dc, HIGH);
    for(uint8_t i = 0; i < len; i++) write_byte(data[i]);
    digitalWrite(_cs, HIGH);
}

void ST7789_76x284::set_window(uint16_t x0, uint16_t y0, uint16_t x1, uint16_t y1){
    x0 += _x_off;
    x1 += _x_off;
    y0 += _y_off;
    y1 += _y_off;
    uint8_t cx[] = { (uint8_t)(x0 >> 8), (uint8_t)(x0), (uint8_t)(x1 >> 8), (uint8_t)(x1) };
    uint8_t cy[] = { (uint8_t)(y0 >> 8), (uint8_t)(y0), (uint8_t)(y1 >> 8), (uint8_t)(y1) };
    send_cmd_data(0x2A, cx, 4); // set column address
    send_cmd_data(0x2B, cy, 4); // set row address
    send_cmd(0x2C);  // Memory write
}

void ST7789_76x284::fillRect(int16_t x, int16_t y, int16_t w, int16_t h, uint16_t color){
    set_window(x, y, x + w - 1, y + h - 1);
    digitalWrite(_dc, HIGH);
    digitalWrite(_cs, LOW);
    for (uint32_t i = 0; i < (uint32_t)w * h; i++) {
        write_byte(color >> 8); write_byte(color & 0xFF);
    }
    digitalWrite(_cs, HIGH);
}

void ST7789_76x284::fillScreen(int16_t color){fillRect(0, 0, _w, _h, color);}

void ST7789_76x284::drawPixel(int16_t x, int16_t y, uint16_t color){
    set_window(x, y, x, y);
    digitalWrite(_dc, HIGH);
    digitalWrite(_cs, LOW);
    write_byte(color >> 8);
    write_byte(color & 0xFF);
    digitalWrite(_cs, HIGH);
}

void ST7789_76x284::drawHLine(int16_t x, int16_t y, int16_t w, uint16_t color) {fillRect(x, y, w, 1, color);}

void ST7789_76x284::drawVLine(int16_t x, int16_t y, int16_t h, uint16_t color) {fillRect(x, y, 1, h, color);}

void ST7789_76x284::drawRect(int16_t x, int16_t y, int16_t w, int16_t h, uint16_t color){
    drawHLine(x,         y,         w, color);
    drawHLine(x,         y + h - 1, w, color);
    drawVLine(x,         y,         h, color);
    drawVLine(x + w - 1, y,         h, color);
}

void ST7789_76x284::drawChar(int16_t x, int16_t y, char c, uint16_t fg, uint16_t bg, uint8_t scale) {
    if(scale > 6 || scale == 5) scale = 6;
    if (c < ' ' || c > 0x87) return;
    uint8_t idx = c - ' ';

    // 15x21 , scales 3, 6
    if (scale % 3 == 0) {
        const uint16_t* g = font_15x21[idx];
        uint8_t mult = scale / 3;

        for (uint8_t row = 0; row < 21; row++) {
            uint16_t line = pgm_read_word(&g[row]);
            for (uint8_t col = 0; col < 15; col++) {
                uint16_t color = (line & (1 << col)) ? fg : bg;
                fillRect((x + 15 * mult) - col * mult - 1, y + row * mult, mult, mult, color);
            }
        }
        // Character gap
        fillRect(x + 15 * mult, y, mult, 21 * mult, bg);

    // 10x14 , scales 2, 4
    } else if (scale % 2 == 0) {
        const uint16_t* g = font_10x14[idx];
        uint8_t mult = scale / 2;

        for (uint8_t row = 0; row < 14; row++) {
            uint16_t line = pgm_read_word(&g[row]);
            for (uint8_t col = 0; col < 10; col++) {
                uint16_t color = (line & (1 << col)) ? fg : bg;
                fillRect((x + 10* mult) - col * mult - 1, y + row * mult, mult, mult, color);
            }
        }
        // Character gap
        fillRect(x + 10 * mult, y, mult, 14 * mult, bg);

    // 5x7, scale 1
    } else {
        const uint8_t* g = font_5x7[idx];
        for (uint8_t row = 0; row < 7; row++) {
            uint8_t h_line = pgm_read_byte(&g[row]);
            for (uint8_t col = 0; col < 5; col++) {
                uint16_t color = (h_line & (1 << col)) ? fg : bg;
                fillRect((x + 5 * scale) - col * scale - 1, y + row * scale, scale, scale, color);
            }
        }
        // Character gap (Vertical bar to the right)
        fillRect(x + 5 * scale, y, scale, 7 * scale, bg);
    }
}

void ST7789_76x284::drawText(int16_t x, int16_t y, const char* str, uint16_t fg, uint16_t bg, uint8_t scale){
    int16_t cx = x;
    while (*str) {
        if (*str == '\n') {
            cx = x;
            y += 8 * scale;
        } else {
            drawChar(cx, y, *str, fg, bg, scale);
            cx += 6 * scale;
        }
        str++;
    }
}

void ST7789_76x284::drawQR(const char* str, int16_t x, int16_t y) {

    const uint8_t QR_VERSION  = 3;
    const uint8_t QUIET       = 2;
    const uint16_t ZONE       = 76;

    // ── Generate QR ──────────────────────────────────────────────────
    uint8_t* buf = (uint8_t*)malloc(qrcode_getBufferSize(QR_VERSION));
    if (!buf) return;
    QRCode qr;
    qrcode_initText(&qr, buf, QR_VERSION, ECC_LOW, str);

    // ── Block size and centering ──────────────────────────────────────
    uint8_t  block    = ZONE / (qr.size + 2 * QUIET);
    uint16_t total_px = (qr.size + 2 * QUIET) * block;
    uint16_t offset_x = (x < 0 ? _w - ZONE : x) + (ZONE - total_px) / 2 + QUIET * block;
    uint16_t offset_y = (y < 0 ? _h - ZONE : y) + (ZONE - total_px) / 2 + QUIET * block;

    // ── Draw ──────────────────────────────────────────────────────────
    fillRect((x < 0 ? _w - ZONE : x), (y < 0 ? _h - ZONE : y), ZONE, ZONE, WHITE);
    for (uint8_t row = 0; row < qr.size; row++)
        for (uint8_t col = 0; col < qr.size; col++)
            if (qrcode_getModule(&qr, col, row))
                fillRect(offset_x + col * block, offset_y + row * block, block, block, BLACK);

    free(buf);
}

void ST7789_76x284::initPWM(int8_t pin) {
    _bl = pin;
    if (_bl < 0) return;

    // 1. Setup the Timer
    ledc_timer_config_t ledc_timer = {
        .speed_mode       = LEDC_LOW_SPEED_MODE, // C3 only supports Low Speed
        .duty_resolution  = LEDC_TIMER_8_BIT,    // 0-255 range
        .timer_num        = LEDC_TIMER_0,
        .freq_hz          = 5000,                // 5kHz frequency
        // .clk_cfg          = LEDC_AUTO_CLK
        .clk_cfg = LEDC_USE_RTC8M_CLK
    };
    ledc_timer_config(&ledc_timer);

    // 2. Setup the Channel
    ledc_channel_config_t ledc_channel = {
        .gpio_num       = (gpio_num_t)_bl,
        .speed_mode     = LEDC_LOW_SPEED_MODE,
        .channel        = LEDC_CHANNEL_0,
        .intr_type      = LEDC_INTR_DISABLE,
        .timer_sel      = LEDC_TIMER_0,
        .duty           = 127,                     // Start at 50% brightness
        .hpoint         = 0
    };
    ledc_channel_config(&ledc_channel);
}

void ST7789_76x284::setBrightness(uint8_t percentage) {
    if (_bl < 0) return;
    if (percentage > 100) percentage = 100;

    // Calculate duty (0-255)
    uint32_t duty = (percentage * 255) / 100;

    // Invert for Active-Low hardware:
    // 100% -> 0 duty
    // 0%   -> 255 duty
    uint32_t inverted_duty = 255 - duty;

    ledc_set_duty(LEDC_LOW_SPEED_MODE, LEDC_CHANNEL_0, inverted_duty);
    ledc_update_duty(LEDC_LOW_SPEED_MODE, LEDC_CHANNEL_0);
}